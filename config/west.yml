## config/west.yml
```yaml
manifest:
  remotes:
    - name: zmkfirmware
      url-base: https://github.com/zmkfirmware

    - name: 280Zo
      url-base: https://github.com/280Zo

    - name: janpfischer
      url-base: https://github.com/janpfischer
  projects:
    - name: zmk
      remote: zmkfirmware
      revision: v0.3.0
      import: app/west.yml

    - name: zmk-pmw3610-driver
      remote: 280Zo
      revision: main

    - name: zmk-dongle-screen
      remote: janpfischer
      revision: 0.1.2
  self:
    path: config
```
